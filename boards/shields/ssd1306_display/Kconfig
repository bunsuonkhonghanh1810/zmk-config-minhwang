## config/boards/shields/scottofrog/Kconfig.shield
```kconfig
config SHIELD_SCOTTOFROG
    def_bool $(shields_list_contains, scottofrog)
    
config LVGL_DISPLAY_WIDTH
    int "LVGL Display Width"
    default 128

config LVGL_DISPLAY_HEIGHT
    int "LVGL Display Height"
    default 64
```

## config/boards/shields/ssd1306_display/Kconfig
```kconfig
config SHIELD_SSD1306_DISPLAY
    bool "SSD1306 Display Shield"
    depends on I2C
```

## config/boards/shields/ssd1306_display/Kconfig.defconfig
```kconfig
if SHIELD_SSD1306_DISPLAY

config ZMK_KEYBOARD_NAME
    default "SSD1306_display"

endif
```

## config/boards/shields/ssd1306_display/Kconfig.shield
```kconfig
config SHIELD_SSD1306_DISPLAY
    def_bool $(shields_list_contains, SSD1306_display)
```
