&i2c1 {
    status = "okay";

    ssd1306@3c {
        compatible = "solomon,ssd1306fb";
        reg = <0x3c>;
        label = "SSD1306";
        width = <128>;
        height = <64>;
        rotation = <0>;
        // reset-gpios = <&gpio0 17 GPIO_ACTIVE_LOW>;  // tùy chọn nếu bạn dùng chân reset
    };
};